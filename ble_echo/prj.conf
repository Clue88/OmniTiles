## CMakeLists.txt
```
cmake_minimum_required(VERSION 3.20.0)

find_package(Zephyr REQUIRED HINTS $ENV{ZEPHYR_BASE})

project(dwm_tag_firmware)

target_sources(app PRIVATE src/main.c)
```

## prj.conf
```kconfig
# --- Bluetooth Configuration ---
CONFIG_BT=y
CONFIG_BT_PERIPHERAL=y
CONFIG_BT_DEVICE_NAME="OmniTile_1"
CONFIG_BT_DEVICE_APPEARANCE=0
CONFIG_BT_MAX_CONN=1
CONFIG_BT_MAX_PAIRED=1

# Enable the Nordic UART Service (NUS) library
CONFIG_BT_NUS=y

# --- SPI Slave Configuration ---
CONFIG_GPIO=y
CONFIG_SPI=y
CONFIG_SPI_SLAVE=y

# --- Logging (Optional but recommended for debugging) ---
CONFIG_LOG=y
CONFIG_USE_SEGGER_RTT=y
CONFIG_LOG_BACKEND_RTT=y
```

## src/main.c
```c
// SPDX-License-Identifier: MIT
// © 2025–2026 Christopher Liu

#include <bluetooth/services/nus.h>
#include <zephyr/bluetooth/bluetooth.h>
#include <zephyr/bluetooth/conn.h>
#include <zephyr/bluetooth/gatt.h>
#include <zephyr/bluetooth/uuid.h>
#include <zephyr/drivers/gpio.h>
#include <zephyr/drivers/spi.h>
#include <zephyr/kernel.h>
#include <zephyr/logging/log.h>

LOG_MODULE_REGISTER(main);

#define SPI_SLAVE_NODE DT_NODELABEL(my_spis)
#define DRDY_GPIO_NODE DT_ALIAS(spis_drdy_gpios)
#define SPI_BUF_SIZE   128

static const struct device* const spi_dev = DEVICE_DT_GET(SPI_SLAVE_NODE);
static const struct gpio_dt_spec drdy_pin = GPIO_DT_SPEC_GET(DRDY_GPIO_NODE, gpios);

K_MSGQ_DEFINE(ble_msgq, SPI_BUF_SIZE, 10, 4);

static uint8_t tx_buffer[SPI_BUF_SIZE];
static uint8_t rx_buffer[SPI_BUF_SIZE];

static const struct spi_config spi_cfg = {
    .operation = SPI_WORD_SET(8) | SPI_TRANSFER_MSB | SPI_OP_MODE_SLAVE,
    .frequency = 4000000,
    .slave = 0,
};

static void set_drdy(bool active) {
  gpio_pin_set_dt(&drdy_pin, active ? 1 : 0);
}

/* --- BLE Callbacks --- */

static void bt_receive_cb(struct bt_conn* conn, const uint8_t* const data, uint16_t len) {
  uint8_t temp_buf[SPI_BUF_SIZE];

  uint16_t copy_len = (len > SPI_BUF_SIZE) ? SPI_BUF_SIZE : len;

  memcpy(temp_buf, data, copy_len);

  if (copy_len < SPI_BUF_SIZE) {
    memset(temp_buf + copy_len, 0, SPI_BUF_SIZE - copy_len);
  }

  if (k_msgq_put(&ble_msgq, temp_buf, K_NO_WAIT) != 0) {
    LOG_WRN("BLE Queue Full");
  } else {
    LOG_INF("BLE RX: %d bytes -> Queue", copy_len);
  }
}

static struct bt_nus_cb nus_cb = {
    .received = bt_receive_cb,
};

static void bt_ready(int err) {
  if (err) {
    LOG_ERR("BLE init failed (err %d)", err);
    return;
  }
  LOG_INF("BLE Initialized");

  err = bt_nus_init(&nus_cb);
  if (err) {
    LOG_ERR("Failed to init NUS (err %d)", err);
    return;
  }

  // Use generic fast advertising.
  err = bt_le_adv_start(BT_LE_ADV_CONN_FAST_1, NULL, 0, NULL, 0);
  if (err) {
    LOG_ERR("Advertising failed (err %d)", err);
  } else {
    LOG_INF("Advertising started");
  }
}

/* --- Main --- */

int main(void) {
  int ret;

  // Init Hardware.
  if (!gpio_is_ready_dt(&drdy_pin) || !device_is_ready(spi_dev)) {
    LOG_ERR("Hardware init failed");
    return -1;
  }
  gpio_pin_configure_dt(&drdy_pin, GPIO_OUTPUT_INACTIVE);

  // Init Bluetooth.
  ret = bt_enable(bt_ready);
  if (ret) {
    LOG_ERR("Bluetooth enable failed");
    return -1;
  }

  LOG_INF("System Ready. Waiting for BLE data...");

  while (1) {
    // Block until data arrives.
    ret = k_msgq_get(&ble_msgq, tx_buffer, K_FOREVER);

    if (ret == 0) {
      struct spi_buf tx_buf = {.buf = tx_buffer, .len = SPI_BUF_SIZE};
      struct spi_buf_set tx = {.buffers = &tx_buf, .count = 1};

      struct spi_buf rx_buf = {.buf = rx_buffer, .len = SPI_BUF_SIZE};
      struct spi_buf_set rx = {.buffers = &rx_buf, .count = 1};

      // Handshake with STM32.
      set_drdy(true);
      ret = spi_transceive(spi_dev, &spi_cfg, &tx, &rx);
      set_drdy(false);

      if (ret == 0) {
        LOG_INF("SPI Transaction Complete");
      }
    }
  }
  return 0;
}
```
